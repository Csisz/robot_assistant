## main/Kconfig.projbuild
```kconfig
menu "LCD Configuration"
    choice LCD_MODULE
        prompt "LCD Module"
        default WAVESHARE_2_8INCH_TOUCH_LCD

    config WAVESHARE_1_47INCH_TOUCH_LCD
        bool "1.47inch Touch LCD"

    config WAVESHARE_2INCH_TOUCH_LCD
        bool "2inch Touch LCD"

    config WAVESHARE_2_8INCH_TOUCH_LCD
        bool "2.8inch Touch LCD"

    config WAVESHARE_3_5INCH_TOUCH_LCD
        bool "3.5inch Touch LCD"
    endchoice

    choice DISPLAY_ROTATION_ANGLE
        prompt "Display Angle"
        default EXAMPLE_DISPLAY_ROTATION_90_DEGREE

    config EXAMPLE_DISPLAY_ROTATION_0_DEGREE
        bool "Set the screen to rotate 0 degrees"

    config EXAMPLE_DISPLAY_ROTATION_90_DEGREE
        bool "Set the screen to rotate 90 degrees"

    config EXAMPLE_DISPLAY_ROTATION_180_DEGREE
        bool "Set the screen to rotate 180 degrees"

    config EXAMPLE_DISPLAY_ROTATION_270_DEGREE
        bool "Set the screen to rotate 270 degrees"
    endchoice
endmenu

menu "Robot Features"
    config ROBOT_ENABLE_KIDS_CHAT
        bool "Enable ChatGPT companion chat"
        default y

    config ROBOT_ENABLE_VOICE_INPUT
        bool "Enable microphone voice input"
        depends on ROBOT_ENABLE_KIDS_CHAT
        default y

    config ROBOT_ENABLE_VOICE_WEB_ROUTE
        bool "Expose voice input web test routes"
        depends on ROBOT_ENABLE_VOICE_INPUT
        default y

    config ROBOT_CHAT_BACKEND_HOST
        string "Chat backend host"
        default "192.168.1.234"
        depends on ROBOT_ENABLE_KIDS_CHAT

    config ROBOT_CHAT_BACKEND_PORT
        int "Chat backend port"
        default 8000
        depends on ROBOT_ENABLE_KIDS_CHAT

    config ROBOT_CHAT_BACKEND_PATH
        string "Chat backend path"
        default "/api/robot/chat"
        depends on ROBOT_ENABLE_KIDS_CHAT

    config ROBOT_CHAT_DEVICE_ID
        string "Chat device id"
        default "robot_assistant_esp32s3"
        depends on ROBOT_ENABLE_KIDS_CHAT

    config ROBOT_CHAT_LOCALE
        string "Chat locale"
        default "hu-HU"
        depends on ROBOT_ENABLE_KIDS_CHAT

    config ROBOT_WIFI_TRY_HIDDEN_PROFILES
        bool "Try WiFi profiles directly for hidden SSIDs"
        default n

    config ROBOT_VOICE_UPLOAD_CHUNK_BYTES
        int "Voice upload chunk size in bytes"
        range 4096 65536
        default 16384
        depends on ROBOT_ENABLE_VOICE_INPUT

    config ROBOT_VOICE_BACKEND_PATH
        string "Voice chat backend path"
        default "/api/robot/voice-chat"
        depends on ROBOT_ENABLE_KIDS_CHAT
endmenu
```

## sdkconfig.defaults
```kconfig
CONFIG_PARTITION_TABLE_CUSTOM=y
CONFIG_PARTITION_TABLE_CUSTOM_FILENAME="partitions.csv"
CONFIG_PARTITION_TABLE_FILENAME="partitions.csv"
CONFIG_PARTITION_TABLE_OFFSET=0x8000

# LCD module selection
CONFIG_WAVESHARE_2_8INCH_TOUCH_LCD=y

# Display rotation: 90 degrees (landscape 320x240)
CONFIG_EXAMPLE_DISPLAY_ROTATION_90_DEGREE=y

# PSRAM / SPIRAM (required for LVGL DMA buffers)
CONFIG_SPIRAM=y
CONFIG_SPIRAM_MODE_OCT=y
CONFIG_SPIRAM_SPEED_80M=y
CONFIG_SPIRAM_FETCH_INSTRUCTIONS=y
CONFIG_SPIRAM_RODATA=y

# Reserve 64 KB of internal DMA-capable RAM so SDMMC, I2S, and JPEG DMA
# allocations always have headroom even when SPIRAM malloc is under pressure.
CONFIG_SPIRAM_MALLOC_RESERVE_INTERNAL=65536

# Product mode defaults
CONFIG_ROBOT_ENABLE_KIDS_CHAT=y
# CONFIG_ROBOT_ENABLE_VOICE_INPUT is not set
# CONFIG_ROBOT_ENABLE_VOICE_WEB_ROUTE is not set
CONFIG_ROBOT_CHAT_BACKEND_HOST="192.168.1.234"
CONFIG_ROBOT_CHAT_BACKEND_PORT=8000
CONFIG_ROBOT_CHAT_BACKEND_PATH="/api/robot/chat"
CONFIG_ROBOT_CHAT_DEVICE_ID="robot_assistant_esp32s3"
CONFIG_ROBOT_CHAT_LOCALE="hu-HU"
```
